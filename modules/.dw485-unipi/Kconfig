## modules/.dw485-unipi/Kconfig
```kconfig
#
# The 8250/16550 serial drivers.  You shouldn't be in this list unless
# you somehow have an implicit or explicit dependency on SERIAL_8250.
#

config SERIAL_8250_DW_UNIPI
	tristate "Support for Synopsys DesignWare 8250 in 485 mode on UniPi "
	depends on SERIAL_8250
	help
	  Selecting this option will enable handling of 485 ports on UniPi
	  controllers .


#config RXTX_LED_TRIG
#       bool "RXTX Serial LED Triggers"
#       depends on LEDS_CLASS && LEDS_TRIGGERS
#       help
#         This option adds LED triggers for RX/TX serial activity.
#
#         Say Y here if you are working on a system with led-class supported
#         LEDs and you want to use them as activity indicators for serial port.
```

## modules/unipi-id/src/Kconfig
```kconfig
config UNIPI_ID
	tristate "Unipi-id nvmem parser"
	default m
	help
	    Parse Eprom to identify Unipi controller and modules
	    Module has name unipi-id
```

## modules/unipi-mfd/src/Kconfig
```kconfig
config UNIPI_SPI
	tristate "Unipi spi protocol driver"
	default m
	help
	    Spi protocol driver for communicating with Unipi IO boards
	    Module has name unipi.ko

config UNIPI_MODBUS
	tristate "Character device driver"
	depends on UNIPI_SPI
	default m
	help
	    Driver of character device /dev/unipichannel enabling access 
	    to Unipi IO boards.

config UNIPI_IOGROUP
	tristate

config UNIPI_MFD
	tristate "Unipi multifunctional device (IO board)"
	default m
	select UNIPI_IOGROUP
	help
	    Unipi IO board as multifunctional device. Handle interrupt from 
	    device. Exports common properties to sysfs.

config UNIPI_LED
	tristate "LED on Unipi IO board"
	depends on UNIPI_MFD
	default m

config UNIPI_GPIO
	tristate "Digital inputs and outputs on Unipi IO board"
	depends on UNIPI_MFD
	default m

config UNIPI_IIO
	tristate "Analog inputs and outputs on Unipi IO board"
	depends on UNIPI_MFD
	default m

config UNIPI_UART
	tristate "Uart port on Unipi IO board"
	depends on UNIPI_MFD
	default m

config UNIPI_DALI
	tristate "Dali port on Unipi IO board"
	depends on UNIPI_MFD
	default n
```

## modules/unipi-rfkill/src/Kconfig
```kconfig
config UNIPI_RFKILL
	tristate "Rfkill support for LTE modems"
	default m
	help
	    Rfkill module to support KTE modems installed on Unipi controllers
	    Module has name unipi-rfkill

config UNIPI_CONSUMER
	tristate "Helper to support switching off regulator"
	default m
	help
	    Rewritten consumer.c to support device tree
```
